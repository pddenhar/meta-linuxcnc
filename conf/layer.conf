## conf/layer.conf
```bitbake
# We have a conf and classes directory, add to BBPATH
BBPATH .= ":${LAYERDIR}"

# We have recipes-* directories, add to BBFILES
BBFILES += "${LAYERDIR}/recipes-*/*/*.bb \
            ${LAYERDIR}/recipes-*/*/*.bbappend"

BBFILE_COLLECTIONS += "meta-linuxcnc"
BBFILE_PATTERN_meta-linuxcnc = "^${LAYERDIR}/"
BBFILE_PRIORITY_meta-linuxcnc = "6"

LAYERDEPENDS_meta-linuxcnc = "core"
LAYERSERIES_COMPAT_meta-linuxcnc = "walnascar"

# Readline triggers a huge number of errors with patch-status
ERROR_QA:remove = "patch-status"
# Needed to build LinuxCNC
HOSTTOOLS += "ps kill whoami pidof ipcs fuser mandb "

# This is needed because LinuxCNC will crash trying to use the BusyBox version of PS
PACKAGECONFIG:pn-bind = "libedit"
PREFERRED_PROVIDER_base-utils = "packagegroup-core-base-utils"
VIRTUAL-RUNTIME_base-utils = "packagegroup-core-base-utils"
VIRTUAL-RUNTIME_base-utils-hwclock = "util-linux-hwclock"
VIRTUAL-RUNTIME_base-utils-syslog = "rsyslog"
```
